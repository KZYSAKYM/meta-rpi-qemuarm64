## conf/layer.conf
```bitbake
# We have a conf and classes directory, add to BBPATH
BBPATH .= ":${LAYERDIR}"

# We have recipes-* directories, add to BBFILES
BBFILES += "${LAYERDIR}/recipes-*/*/*.bb \
            ${LAYERDIR}/recipes-*/*/*.bbappend"

BBFILE_COLLECTIONS += "meta-rpi-qemuarm64"
BBFILE_PATTERN_meta-rpi-qemuarm64 = "^${LAYERDIR}/"
BBFILE_PRIORITY_meta-rpi-qemuarm64 = "15"

LAYERDEPENDS_meta-rpi-qemuarm64 = " \
    core  \
    ${@oe.utils.conditional('MACHINE', 'qemuarm64', '', 'raspberrypi', d)} \
"
LAYERSERIES_COMPAT_meta-rpi-qemuarm64 = "dunfell"

BBMASK_qemuarm64_append .= "|meta-rpi-qemuarm64/recipes-kernel/linux/linux-raspberrypi_%.bbappend"
```
